#include "corne.dtsi"

&default_transform {
    col-offset = <9>;  
};

&kscan0 {
    // Right side column pins (9 columns): D0, D1, D2, D3, D4, D5, D6, D7, E0
    col-gpios = <&pro_micro 9 GPIO_ACTIVE_HIGH>,
                <&pro_micro 8 GPIO_ACTIVE_HIGH>,
                <&pro_micro 7 GPIO_ACTIVE_HIGH>,
                <&pro_micro 6 GPIO_ACTIVE_HIGH>,
                <&pro_micro 5 GPIO_ACTIVE_HIGH>,
                <&pro_micro 4 GPIO_ACTIVE_HIGH>,
                <&pro_micro 3 GPIO_ACTIVE_HIGH>,
                <&pro_micro 2 GPIO_ACTIVE_HIGH>,
                <&pro_micro 1 GPIO_ACTIVE_HIGH>;
};
